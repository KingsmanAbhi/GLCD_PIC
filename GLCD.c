#include "mcc_generated_files/mcc.h"
#include "GLCD.h"
#include "GLCD_8x8.h"






//void GLCD_Init(void)
//{
////    RES_Pin = 0;
////    __delay_ms(50);
//   RES_Pin = 1;
//// 
//   GLCD_WriteCMD(CMD_SET_ADC_NORMAL);      // ADC select   
//
////   __delay_ms(1);
//   
//   GLCD_WriteCMD(CMD_SET_COM_REVERSE);     // SHL Normal
//
////   __delay_ms(1);
//   
//   GLCD_WriteCMD(CMD_SET_BIAS_9);      // LCD bias
//
////   __delay_ms(1);
// 
//   GLCD_WriteCMD(CMD_SET_POWER_CONTROL);      // Power control
//
////   __delay_ms(1);
// 
//    GLCD_WriteCMD(CMD_SET_RESISTOR_RATIO);      // reg resistor select
//
////   __delay_ms(1);
//  
//   GLCD_WriteCMD(CMD_SET_DISP_START_LINE);      // Initial display line 40
//
////   __delay_ms(1);
// 
//   GLCD_WriteCMD(CMD_SET_ALLPTS_NORMAL);      // Normal display
//
////   __delay_ms(1);
// 
//   GLCD_WriteCMD(CMD_SET_DISP_NORMAL);      // REverce display a7
//
////   __delay_ms(1);
//  
//   GLCD_WriteCMD(CMD_SET_VOLUME_FIRST);      // Ref vg select mode
//
////   __delay_ms(1);
//   
//   GLCD_WriteCMD(0x3f);      // Ref vg reg select
//
////   __delay_ms(1);
//
//   GLCD_WriteCMD(CMD_DISPLAY_ON);      // Display ON
//
//   __delay_ms(1);
//   
//   GLCD_WriteCMD(CMD_SET_PAGE);      // Set page address
//
////   __delay_ms(1);
// 
//   GLCD_WriteCMD(CMD_SET_COLUMN_UPPER);      // Set coloumn addr  MSB 
//  
////   __delay_ms(1);
//
//   GLCD_WriteCMD(CMD_SET_COLUMN_LOWER);      // Set coloumn addr LSB
//
////   __delay_ms(1);  
//    
//    
//}

//void GLCD_Init(void)
//{
//    RES_Pin = 0;
//    __delay_ms(50);
//    RES_Pin = 1;
// 
//   GLCD_WriteCMD(0xe2);      // ADC select   
//
//   __delay_ms(1);
//   
//   GLCD_WriteCMD(0xae);     // SHL Normal
//
//   __delay_ms(1);
//   
//   GLCD_WriteCMD(0x40);      // LCD bias
//
//   __delay_ms(1);
// 
//   GLCD_WriteCMD(0xa1);      // Power control
//
//   __delay_ms(1);
// 
//    GLCD_WriteCMD(0xc0);      // reg resistor select
//
//   __delay_ms(1);
//  
//   GLCD_WriteCMD(0xa6);      // Initial display line 40
//
//   __delay_ms(1);
// 
//   GLCD_WriteCMD(0xa2);      // Normal display
//
//   __delay_ms(1);
// 
//   GLCD_WriteCMD(0x2f);      // REverce display a7
//
//   __delay_ms(1);
//   GLCD_WriteCMD(0xf8);      // REverce display a7
//
//   __delay_ms(1);
//   
//   GLCD_WriteData(0x00);
//   __delay_ms(50);
//   
//   GLCD_WriteCMD(0x25);      // Ref vg select mode
//
//   __delay_ms(1);
//   
//   GLCD_WriteCMD(0x81);      // Ref vg select mode
//
//   __delay_ms(1);
//   
//   GLCD_WriteData(170);
//   __delay_ms(50);
//   
//   GLCD_WriteCMD(0xae);      // Ref vg reg select
//
//   __delay_ms(1);
//
//   GLCD_WriteCMD(0xa5);      // Display ON
//
//   __delay_ms(1);
//   
////   GLCD_WriteCMD(CMD_SET_PAGE);      // Set page address
////
////   __delay_ms(1);
//// 
////   GLCD_WriteCMD(CMD_SET_COLUMN_UPPER);      // Set coloumn addr  MSB 
////  
////   __delay_ms(1);
////
////   GLCD_WriteCMD(CMD_SET_COLUMN_LOWER);      // Set coloumn addr LSB
////
////   __delay_ms(1);  
//    
//    
//}



//



void GLCD_Init(void)
{
   CS_Pin = 0;
   RES_Pin = 1;
   RES_Pin = 0;
   __delay_ms(2);
   RES_Pin = 1;
   __delay_ms(2);
 
   GLCD_WriteCMD(0xA2);        

   GLCD_WriteCMD(0xA0);     

   GLCD_WriteCMD(0xC8);      
 
   GLCD_WriteCMD(0xC0);      
 
   GLCD_WriteCMD(0x40);      

   __delay_ms(0);
  
   GLCD_WriteCMD(0x25);      

   __delay_ms(0);
 
   GLCD_WriteCMD(0x81);      

   __delay_ms(0);
 
   GLCD_WriteCMD(0x19);      

   __delay_ms(0);
  
   GLCD_WriteCMD(0x2F);      

   __delay_ms(0);
   
   GLCD_WriteCMD(0x3f);      

   __delay_ms(0);

   GLCD_WriteCMD(0xAF);      // Display ON  
    
}



void GLCD_WriteCMD(uint8_t cmd)
{
    A0_Pin = 0;
    CS_Pin = 0;
//    RES_Pin = 0;
    SPI_WriteByte(cmd);
    //while(!SSPSTATbits.BF);
    CS_Pin = 1;
}

void GLCD_WriteData(uint8_t data)
{
    A0_Pin = 1;
    CS_Pin = 0;
//    RES_Pin = 0;
    SPI_WriteByte(data);
   // while(!SSPSTATbits.BF);
    CS_Pin = 1;
}

/* set the cursor to perticular page and coloumn */
void LCD_SET_PAGE(unsigned char page,unsigned char col)
{
   unsigned char msb,lsb;
   msb      =   (((col & 0xF0) >> 4)| 0x10);
   lsb      =   (col & 0x0F);
   GLCD_WriteCMD(page);
   __delay_ms(1);
   GLCD_WriteCMD(msb);
   __delay_ms(1);
   GLCD_WriteCMD(lsb);
   __delay_ms(1);
}


/* clears entire lcd or clears all page*/
void LCD_CLEAR(void)
{
   unsigned char i = 0,j = 0;
   
   LCD_SET_PAGE(PAGE1,COL1);      // initial page, col
      
   for(i = 0; i < 8; i ++)
   {
          for(j = 0; j < 128; j ++)
            GLCD_WriteData(0x00);
          LCD_SET_PAGE(PAGE1 + i + 1 , COL1);   // increment page
   }
   
   LCD_SET_PAGE(PAGE1,COL1);      // initial page,col
       
}

void lcd_display_char(U8 charecter)
{
  U8 width = 0, index = 0, data = 0;
  
  width = get_width_of_char(charecter);
  for(index = 0; index < width; index++)
  {
    data = get_data_from_data_table(charecter, index);
    GLCD_WriteData(data);
  }
}

void lcd_display_string(U8 *str)
{
  if(str == NULL)
    return;
    
  while(*str != (U32)NULL)
  {
    lcd_display_char(*str);
    str++;
  }
}






//U8 get_data_from_data_table(U8 character, U8 index)
//{
//    const U8 data_table[3][5] =
//    {
//    }
//    
//    // Convert character to an index in the data table
//        U8 table_index = 0;
//        if (character >= 'A' && character <= 'Z')
//        {
//          table_index = character - 'A';
//        }
//        else if (character >= 'a' && character <= 'z')
//        {
//          table_index = character - 'a';
//        }
//        else if (character >= '0' && character <= '9')
//        {
//          table_index = character - '0' + 26;
//        }
//        else if (character == '-')
//        {
//          table_index = 36;
//        }
//        else if (character == '_')
//        {
//          table_index = 37;
//        }
//        else
//        {
//          // Character not found in the data table
//          return 0;
//        }
//
//        // Check if the index is within bounds
//        if (index >= 0 && index < 5)
//        {
//          // Return the data for the segment of the character at the given index
//          return data_table[table_index][index];
//        }
//        else
//        {
//          // Index out of bounds
//          return 0;
//        }
//
//}






//WARNING: This Font Require X-GLCD Lib.
//         You can not use it with MikroE GLCD Lib.

//Font Generated by MikroElektronika GLCD Font Creator 1.2.0.0
//MikroElektronika 2011 
//http://www.mikroe.com 

//GLCD FontName : Courier8x8
//GLCD FontSize : 8 x 8

const unsigned short Courier8x8[] = {
        0x05, 0x00, 0x00, 0x00, 0x00, 0x00, 0x00, 0x00, 0x00,  // Code for char  
        0x05, 0x00, 0x00, 0x00, 0x00, 0xFE, 0x00, 0x00, 0x00,  // Code for char !
        0x06, 0x00, 0x00, 0x00, 0x0E, 0x00, 0x0E, 0x00, 0x00,  // Code for char "
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        0x06, 0x00, 0x00, 0x00, 0xFC, 0xFC, 0xFC, 0x00, 0x00   // Code for char 
        };



//WARNING: This Font Require X-GLCD Lib.
//         You can not use it with MikroE GLCD Lib.

//Font Generated by MikroElektronika GLCD Font Creator 1.2.0.0
//MikroElektronika 2011 
//http://www.mikroe.com 

//GLCD FontName : Tahoma8x8
//GLCD FontSize : 8 x 8

const unsigned short Tahoma8x8[] = {
        0x05, 0x00, 0x00, 0x00, 0x00, 0x00, 0x00, 0x00, 0x00,  // Code for char  
        0x02, 0x00, 0x7E, 0x00, 0x00, 0x00, 0x00, 0x00, 0x00,  // Code for char !
        0x03, 0x07, 0x00, 0x07, 0x00, 0x00, 0x00, 0x00, 0x00,  // Code for char "
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        0x03, 0xFE, 0x02, 0xFE, 0x00, 0x00, 0x00, 0x00, 0x00   // Code for char 
        };




// Function to print a character on the graphical display
void printCharacter(uint8_t x, uint8_t y, uint8_t character) {
    // Set the X and Y coordinates
    // Assuming the graphical display has a resolution of 128x64 pixels
    // Each character is 8 pixels wide and 8 pixels high
    uint8_t startX = x * 8;
    uint8_t startY = y * 8;

    // Loop through each row of the character pattern
    for (uint8_t row = 0; row <= 8; row++) 
    {
        // Set the starting address of the row
//        uint8_t address = (startY + row) * 128 + startX;

        // Send the command to set the column address
//        GLCD_WriteCMD(0x15);
//        GLCD_WriteCMD(address & 0xFF);
//        GLCD_WriteCMD((address >> 8) & 0xFF);
//
//        // Send the command to set the page address
//        GLCD_WriteCMD(0xB0 | (startY + row) / 8);

        // Send the character pattern for the current row
        GLCD_WriteData(Tahoma8x8[(character-32) * 9 + row]);
        
    }
}
        
  